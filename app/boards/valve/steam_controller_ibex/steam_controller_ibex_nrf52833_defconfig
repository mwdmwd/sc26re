## app/tests/haptics_stereo/testcase.yaml
```yaml
# SPDX-License-Identifier: AGPL-3.0-or-later

tests:
  app.haptics.stereo:
    platform_allow:
      - native_sim
    tags:
      - haptics
      - pcm
```

## app/tests/imu_threshold/testcase.yaml
```yaml
# SPDX-License-Identifier: AGPL-3.0-or-later

tests:
  app.imu.threshold:
    platform_allow:
      - native_sim
    tags:
      - imu
      - sensor
      - rtio
```

## zephyr/manifest/west.yml
```yaml
manifest:
  remotes:
  - name: zephyrproject
    url-base: https://github.com/zephyrproject-rtos

  projects:
  - name: zephyr
    remote: zephyrproject
    revision: 1f6485eca25431b5ff27ce9a754218c9e559bbbb
    path: zephyr
    west-commands: scripts/west-commands.yml
  - name: cmsis
    remote: zephyrproject
    revision: 512cc7e895e8491696b61f7ba8066b4a182569b8
    path: modules/hal/cmsis
  - name: cmsis_6
    remote: zephyrproject
    repo-path: CMSIS_6
    revision: 30a859f44ef8ab4dc8f84b03ed586fd16ccf9d74
    path: modules/hal/cmsis_6
  - name: hal_nordic
    remote: zephyrproject
    revision: 44fd3d44b15cb75f80a25b4679f91d2787e28664
    path: modules/hal/nordic
  - name: hal_st
    remote: zephyrproject
    revision: 7a792882847223c72944791e0c48eed6101e6569
    path: modules/hal/st
  - name: mbedtls
    remote: zephyrproject
    revision: a3e190fe44c78d1ba67f55979e1257328cc7d0d8
    path: modules/crypto/mbedtls
  - name: tf-psa-crypto
    remote: zephyrproject
    revision: dc575a2ddcc8cb16275d24c42a52eaf79ebe2231
    path: modules/crypto/tf-psa-crypto

  self:
    path: manifest
```
