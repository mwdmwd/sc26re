## app/boards/valve/steam_controller_ibex/Kconfig.defconfig
```kconfig
# SPDX-License-Identifier: AGPL-3.0-or-later

if BOARD_STEAM_CONTROLLER_IBEX

config BT_CTLR
	default BT

endif
```

## app/boards/valve/steam_controller_ibex/Kconfig.steam_controller_ibex
```kconfig
# SPDX-License-Identifier: AGPL-3.0-or-later

config BOARD_STEAM_CONTROLLER_IBEX
	select SOC_NRF52833_QIAA
```

## app/boards/valve/steam_controller_ibex/board.yml
```yaml
# SPDX-License-Identifier: AGPL-3.0-or-later

board:
  name: steam_controller_ibex
  full_name: Steam Controller Ibex
  vendor: valve
  socs:
  - name: nrf52833
```
